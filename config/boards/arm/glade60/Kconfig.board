## config/boards/arm/glade60/Kconfig.defconfig
```kconfig
if BOARD_GLADE60

config ZMK_KEYBOARD_NAME
  default "glade60"

config BOARD
  default "glade60"

config ZMK_SPLIT
  default n

config BT_CTLR
  default BT

config ZMK_BLE
  default y

config ZMK_USB
  default y

config ZMK_BATTERY_VOLTAGE_DIVIDER
  default n

if USB

config USB_NRFX
  default y

config USB_DEVICE_STACK
  default y

endif # USB

endif # BOARD_GLADE60
```
